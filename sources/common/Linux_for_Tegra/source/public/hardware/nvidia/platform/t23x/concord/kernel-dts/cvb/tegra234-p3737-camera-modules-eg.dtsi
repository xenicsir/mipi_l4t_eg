/*
 * Copyright (c) 2022, NVIDIA CORPORATION.  All rights reserved.
 *
 * This program is free software; you can redistribute it and/or modify it
 * under the terms and conditions of the GNU General Public License,
 * version 2, as published by the Free Software Foundation.
 *
 * This program is distributed in the hope it will be useful, but WITHOUT
 * ANY WARRANTY; without even the implied warranty of MERCHANTABILITY or
 * FITNESS FOR A PARTICULAR PURPOSE.  See the GNU General Public License for
 * more details.
 *
 * You should have received a copy of the GNU General Public License
 * along with this program.  If not, see <http://www.gnu.org/licenses/>.
 */

/* These headers don't exist yet.
 * TODO: add below headers for corresponding sensor modules.
 * #include "tegra234-p3737-0000-camera-e3377-a00.dtsi"
 * #include "tegra234-p3737-0000-camera-e3326-a00.dtsi"
 * #include "tegra234-p3737-0000-camera-vivid.dtsi"
 * #include "tegra234-p3737-0000-camera-imx274-a00.dtsi"
 */

/*#include "tegra234-p3737-0000-camera-ar0234-a00.dtsi"				//remove for imx219 cams to work properly on X230D(fd)
#include "tegra234-p3737-0000-camera-p3762-a00.dtsi"				TODO: make compatible with X230D(fd)
#include "tegra234-p3737-0000-camera-e3331-a00.dtsi"
#include "tegra234-p3737-0000-camera-e3333-a00.dtsi"
#include "tegra234-p3737-0000-camera-imx185-a00.dtsi"
#include "tegra234-p3737-0000-camera-imx390-a00.dtsi"
#include "tegra234-p3737-0000-camera-imx274-dual.dtsi"*/
//#include "tegra234-p3737-0000-camera-imx219-auvidea-M222.dtsi"			//added for imx219 support on X230D(fd
#include "tegra234-p3737-0000-camera-eg-auvidea.dtsi"


/ {
	tegra-camera-platform {
		/**
		* tpg_max_iso = <>;
		* Max iso bw for 6 streams of tpg
		* streams * nvcsi_freq * PG_bitrate / RG10 * BPP
		* 6 * 102Mhz * 32 bits/ 10 bits * 2 Bps
		* = 3916.8 MBps
		*/
		tpg_max_iso = <3916800>;
	};

	/* set camera gpio direction to output */

};
