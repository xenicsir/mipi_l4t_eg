// SPDX-License-Identifier: GPL-2.0-only

/*
 * Hadron DM's camera connectors sit behind a real PCA9540 I2C mux chip
 * (reg 0x70 on cam_i2c/i2c@3180000) rather than the GPIO-toggled mux used
 * on Forecr/devkit carriers — see
 * tegra234-p3767-camera-cti-eg-cams-dione.dts for the full rationale.
 */
#define HADRON_DM_CAM_I2C_MUX

/*
 * Hadron DM ships a precompiled kernel/nvidia-oot we don't patch (see
 * PRISTINE_KERNEL in eg_config.yaml and tegra234-p3767-camera-cti-eg-cams-
 * dione.dts) -- the shared .dtsi below renumbers the EngineCore camera's
 * modes accordingly (Y16/RAW16 modes removed, RGB888/YUYV modes shifted
 * down) to match eg_ec_b@16/eg_ec_c@16 as actually defined by the base
 * dione overlay on this vendor.
 */
#define PRISTINE_KERNEL

#include "tegra234-p3767-camera-p3768-common-eg-cam0-ec-1-lane.dtsi"

/ {
	overlay-name = "Exosens Cameras for Connect Tech Hadron DM. CAM0:EC_1_lane";
};
