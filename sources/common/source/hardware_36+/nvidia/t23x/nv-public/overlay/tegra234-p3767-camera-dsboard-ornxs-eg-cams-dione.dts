// SPDX-License-Identifier: GPL-2.0-only
// SPDX-FileCopyrightText: Copyright (c) 2023-2024, NVIDIA CORPORATION & AFFILIATES. All rights reserved.

/dts-v1/;
/plugin/;

#define DSBOARD_ORNXS_CAM_I2C_MUX
#define CAM0_LANE_SWAP

#include "tegra234-p3767-camera-common-eg-cams-dione.dtsi"

/ {
	overlay-name = "Exosens Cameras for DSBOARD-ORNXS";
#ifdef EG_CSI_22PIN
	jetson-header-name = "Jetson 22pin CSI Connector";
#else
	jetson-header-name = "Jetson 24pin CSI Connector";
#endif
	compatible = JETSON_COMPATIBLE_P3768;
};
