// Overlay that disables the two IMX219 nodes present in base_imx219_active.dts
/dts-v1/;
/plugin/;
/ {
	compatible = "nvidia,tegra234";

	fragment@0 {
		target-path = "/cam_i2cmux/i2c@0/rbpcv2_imx219_a@10";
		__overlay__ { status = "disabled"; };
	};

	fragment@1 {
		target-path = "/cam_i2cmux/i2c@1/rbpcv2_imx219_c@10";
		__overlay__ { status = "disabled"; };
	};
};
