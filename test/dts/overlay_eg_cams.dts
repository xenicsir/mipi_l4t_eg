// Minimal overlay for "Exosens Cameras" — adds a harmless test node, no IMX changes
/dts-v1/;
/plugin/;
/ {
	compatible = "nvidia,tegra234";

	fragment@0 {
		target-path = "/";
		__overlay__ {
			eg-cameras-test { status = "okay"; };
		};
	};
};
